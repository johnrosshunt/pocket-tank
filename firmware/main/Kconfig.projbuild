## firmware/main/Kconfig.projbuild
```kconfig
menu "pocket-tank"
    config POCKET_TANK_DISPLAY_TAB5
        bool "Drive the M5Stack Tab5's ST7123 MIPI-DSI panel"
        default n
        help
            The Tab5 port (docs/boards/m5stack-tab5.md). Off = stub display port.
    config POCKET_TANK_DISPLAY_SH8601
        bool "Drive the Waveshare 1.8in AMOLED (SH8601 / CO5300 over QSPI)"
        default n
        help
            Enable for the real board. Off = stub display port (QEMU / compile-only).
    config POCKET_TANK_TOUCH_TAB5
        bool "Read the M5Stack Tab5's ST7123 touch (taps / holds)"
        default n
        help
            The Tab5 port (docs/boards/m5stack-tab5.md). Off = stub touch port.
    config POCKET_TANK_RTC_RX8130
        bool "Wall clock from the Tab5's RX8130CE RTC (off: the PCF85063)"
        default n
        help
            The Tab5 port (docs/boards/m5stack-tab5.md).
    config POCKET_TANK_AUDIO_TAB5
        bool "Play the sound bank through the Tab5's ES8388 codec + NS4150B amp (I2S)"
        default n
        help
            The Tab5 port (docs/boards/m5stack-tab5.md, docs/AUDIO.md). Off = stub audio port: cues compile, nothing plays.
    config POCKET_TANK_NO_PIE
        bool "Disable the PIE SIMD inference kernel (scalar dot products)"
        default n
        help
            Enable for a QEMU build if the emulator lacks ESP32-S3 PIE support.
endmenu
```
